## main/Kconfig.projbuild
```kconfig
menu "Snapclient Configuration"
    config SNAPSERVER_USE_MDNS
        bool "Use mDNS"
        default true
        help
            Use mDNS to look for the snapserver to connect to on the local network.

    config SNAPSERVER_HOST
        string "Snapserver host/fallback host"
        default "192.168.1.158"
        help
            Host (IP or name) of snapserver to connect to when mDNS is disabled,
            or as a fallback if mDNS service discovery fails.

    config SNAPSERVER_PORT
        int "Snapserver port/fallback port"
        default 1704
        help
            Port of the snapserver to connect to when mDNS is disabled,
            or as a fallback if mDNS service discovery fails.

    config SNAPCLIENT_NAME
        string "snapclient name"
        default "ESP32-Caster"
        help
            Name of the client to register the snapserver.

	menu "HTTP Server Setting"
		config WEB_PORT
			int "User interface HTTP Server Port"
			default 8000
			help
				HTTP server port to use.
	endmenu

	config USE_SAMPLE_INSERTION
        bool "Use sample insertion"
        default true
        help
            There are two syncronization implementations.

            1. APLL tuning (ONLY use with DACs having MCLK input)
            2. sample insertion (duplicates a sample now and then to keep up sync)

            Both approaches have similar performance keeping clients in sync <= 500µs

endmenu
```
